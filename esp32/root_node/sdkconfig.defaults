## esp32/root_node/sdkconfig.defaults
```kconfig
CONFIG_IDF_TARGET="esp32s3"
CONFIG_ESPTOOLPY_FLASHSIZE_16MB=y
CONFIG_ESPTOOLPY_FLASHSIZE="16MB"
CONFIG_PARTITION_TABLE_CUSTOM=y
CONFIG_PARTITION_TABLE_CUSTOM_FILENAME="partitions.csv"
CONFIG_ESP_DEFAULT_CPU_FREQ_MHZ_240=y
CONFIG_ESP_DEFAULT_CPU_FREQ_MHZ=240
CONFIG_FREERTOS_HZ=1000
CONFIG_ESP_CONSOLE_NONE=y
CONFIG_ESP_CONSOLE_SECONDARY_NONE=y
CONFIG_LOG_DEFAULT_LEVEL_WARN=y
CONFIG_LOG_DEFAULT_LEVEL=2
CONFIG_SPIRAM=y
CONFIG_SPIRAM_MODE_OCT=y
CONFIG_SPIRAM_SPEED_80M=y
CONFIG_SPIRAM_USE_MALLOC=y
CONFIG_COMPILER_OPTIMIZATION_PERF=y
CONFIG_ESP_MAIN_TASK_STACK_SIZE=8192
CONFIG_FREERTOS_TIMER_TASK_STACK_DEPTH=4096
CONFIG_ESP_TIMER_TASK_STACK_SIZE=4096
CONFIG_LWIP_IP_FORWARD=y
CONFIG_LWIP_IPV4_NAPT=y
CONFIG_MESH_LITE_ENABLE=y
CONFIG_ESP_MESH_LITE_OTA_ENABLE=y
CONFIG_OTA_DATA_LEN=1376
CONFIG_OTA_WND_DEFAULT=8256
CONFIG_OTA_AUTO_RESTART=n
CONFIG_OTA_AUTO_CANCEL_ROLLBACK=n
CONFIG_MESH_LITE_NODE_INFO_REPORT=y
CONFIG_MESH_LITE_REPORT_INTERVAL=10
CONFIG_MESH_LITE_MAXIMUM_NODE_NUMBER=100
CONFIG_MESH_LITE_MAXIMUM_LEVEL_ALLOWED=6
CONFIG_MESH_LITE_MAX_ROUTER_NUMBER=5
CONFIG_MESH_LITE_VENDOR_ID_0=67
CONFIG_MESH_LITE_VENDOR_ID_1=66
CONFIG_MESH_LITE_ID=49
CONFIG_JOIN_MESH_IGNORE_ROUTER_STATUS=y
CONFIG_JOIN_MESH_WITHOUT_CONFIGURED_WIFI_INFO=y
CONFIG_BRIDGE_SOFTAP_SSID="CABINET_MESH"
CONFIG_BRIDGE_SOFTAP_PASSWORD="Mesh@2026"
CONFIG_BRIDGE_SOFTAP_MAX_CONNECT_NUMBER=6
CONFIG_BRIDGE_SOFTAP_SSID_END_WITH_THE_MAC=y
```
